## configs/defconfig
```kconfig
CONFIG_CORE_LOG_ENABLE=y
CONFIG_CORE_LOG_LINENUM=y
CONFIG_CORE_LOG_TAG=y
CONFIG_CORE_QUEUE_DEFAULT_LOCKFREE=y
```

## core/include/core/Kconfig
```kconfig
menu "Core Configuration"

config CORE_BUILD_EXAMPLE
    bool "Build example binaries"
    default y

config CORE_BUILD_REFERENCES
    bool "Build reference binaries"
    default n

config CORE_BUILD_DOXYGEN
    bool "Build doxygen documentation"
    default n

config CORE_BUILD_DOXYGEN_HTML
    depends on CORE_BUILD_DOXYGEN
    bool "Generate HTML documentation"
    default y

config CORE_BUILD_DOXYGEN_MAN
    depends on CORE_BUILD_DOXYGEN
    bool "Generate MANPAGE"
    default n

source "audio/Kconfig"
source "utils/Kconfig"
source "graphics/Kconfig"

endmenu
```

## core/include/core/assets/Kconfig
```kconfig
menu "Asset Management"

config CORE_ASSET_STARTUP_SCAN
    bool "Scan assets on startup"
    default y

config CORE_ASSET_SCAN_AUDIO_ENABLE
    depends on CORE_ASSET_STARTUP_SCAN
    bool "Scan for audio assets"
    default y

config CORE_ASSET_SCAN_MODELS_ENABLE
    depends on CORE_ASSET_STARTUP_SCAN
    bool "Scan for model assets"
    default y

config CORE_ASSET_SCAN_TEXTURE_ENABLE
    depends on CORE_ASSET_STARTUP_SCAN
    bool "Scan for texture assets"
    default y

config CORE_ASSET_SCAN_SPRITESHEET_ENABLE
    depends on CORE_ASSET_STARTUP_SCAN
    bool "Scan for spritesheet assets"
    default y

config CORE_ASSET_SCAN_SHADERS_OPENGL
    depends on CORE_ASSET_STARTUP_SCAN
    bool "Scan for OpenGL Shaders"
    default y if CORE_RENDERER_OPENGL

config CORE_ASSET_SCAN_SHADERS_VULKAN
    depends on CORE_ASSET_STARTUP_SCAN
    bool "Scan for Vulkan Shaders"
    default y if CORE_RENDERER_VULKAN

endmenu
```

## core/include/core/audio/Kconfig
```kconfig
menu "Audio"

config CORE_AUDIO_ALLOW_FREQUENCY_CHANGE
    bool "Allow frequency change"
    default n
    help 
        If set to n, SDL2 will transparently handle frequency changes if the sound
        device does not support the requested frequency

config CORE_AUDIO_ALLOW_FORMAT_CHANGE
    bool "Allow format change"
    default n
    help 
        If set to n, SDL2 will transparently handle frequency changes if the sound
        device does not support the requested format

config CORE_AUDIO_ALLOW_CHANNEL_CHANGE
    bool "Allow channel change"
    default n
    help 
        If set to n, SDL2 will transparently handle frequency changes if the sound
        device does not support the requested channel

config CORE_AUDIO_ALLOW_SAMPLE_CHANGE
    bool "Allow sample change"
    default n
    help 
        If set to n, SDL2 will transparently handle frequency changes if the sound
        device does not support the requested sample

config CORE_AUDIO_ALLOW_ALL_CHANGE
    bool "Allow all change"
    default n
    select CORE_AUDIO_ALLOW_FREQUENCY_CHANGE
    select CORE_AUDIO_ALLOW_FORMAT_CHANGE
    select CORE_AUDIO_ALLOW_CHANNEL_CHANGE
    select CORE_AUDIO_ALLOW_SAMPLE_CHANGE
    help 
        If set to n, SDL2 will transparently handle frequency changes if the sound
        device does not support the requested audio spec

menu "Supported Formats"

    config CORE_AUDIO_FORMAT_FLAC
        bool "FLAC"
        default n

    config CORE_AUDIO_FORMAT_MOD
        bool "MP3"
        default y

    config CORE_AUDIO_FORMAT_MP3
        bool "MP3"
        default y

    config CORE_AUDIO_FORMAT_OGG
        bool "Ogg Vorbis"
        default y

    config CORE_AUDIO_FORMAT_MID
        bool "MP3"
        default y

    config CORE_AUDIO_FORMAT_OPUS
        bool "Ogg Opus"
        default y

endmenu

config CORE_AUDIO_MIX_CHANNELS
    int "Mix Channel Count"
    default 8
    help
        Defines how many mixing channels are allocated. If you need more than 8 sounds
        playing at the same time, try increasing this number

config CORE_AUDIO_USE_OPENAL
    bool "Use OpenAL as mixer"
    default n

endmenu
```

## core/include/core/ecs/Kconfig
```kconfig
menu "ECS"

config CORE_ECS_COMPONENT_TRANSFORM
    bool "Transform Component"
    default y

config CORE_ECS_COMPONENT_AUDIO
    bool "Audio Component"
    depends on CORE_ECS_COMPONENT_TRANSFORM
    default y

config CORE_ECS_COMPONENT_CAMERA
    bool "Camera Component"
    depends on CORE_ECS_COMPONENT_TRANSFORM
    default y

config CORE_ECS_COMPONENT_INPUT
    bool "Input Component"
    default y

config CORE_ECS_COMPONENT_RENDER
    bool "Render Component"
    depends on CORE_ECS_COMPONENT_TRANSFORM
    default y

config CORE_ECS_COMPONENT_MESH
    bool "Mesh Component"
    depends on CORE_ECS_COMPONENT_RENDER
    default y

config CORE_ECS_COMPONENT_SPRITE
    bool "Sprite Component"
    depends on CORE_ECS_COMPONENT_RENDER
    default y


endmenu
```

## core/include/core/graphics/Kconfig
```kconfig
menu "Graphics"

choice
    prompt "Default Renderer"
    default CORE_RENDERER_DEFAULT_OPENGL
    help
        Specifies the default renderer to use

    config CORE_RENDERER_DEFAULT_OPENGL
        bool "OpenGL"
        select CORE_RENDERER_OPENGL

    config CORE_RENDERER_DEFAULT_VULKAN
        bool "Vulkan"
        select CORE_RENDERER_VULKAN
endchoice

config CORE_RENDERER_OPENGL
    bool "Enable support for OpenGL Renderer"
    default n

config CORE_RENDERER_VULKAN
    bool "Enable support for Vulkan Renderer"
    default n

endmenu
```

## core/include/core/utils/Kconfig
```kconfig
menu "Utils"

config CORE_PROFILER_ENABLE
    bool "Enable profiling"
    help
        Depends on third-party library - easy_profiler

config CORE_LOG_ENABLE
    bool "Enable Logging"
    help
        Enables logging
        Depends on third-party library - spdlog
        
source "Kconfig.logging"

source "Kconfig.queue"

endmenu
```

## core/include/core/utils/Kconfig.logging
```kconfig
menu "Logging"
    depends on CORE_LOG_ENABLE

config CORE_LOG_LINENUM
    bool "Print line number in logs"
    depends on CORE_LOG_ENABLE

config CORE_LOG_TAG
    bool "Print tags in logs"
    depends on CORE_LOG_ENABLE

config CORE_LOG_LEVEL
    depends on CORE_LOG_ENABLE
    int "Logging level"
    range 0 6
    default 6
    help
        Logging level
        0 - NONE
        1 - ERROR
        2 - CRITICAL
        3 - WARN
        4 - INFO
        5 - DEBUG
        6 - TRACE

endmenu
```

## core/include/core/utils/Kconfig.queue
```kconfig
menu "Queue"

choice
    prompt "Queue Implementation"
    default CORE_QUEUE_DEFAULT_STDMUTEX
    help
        This option selects the underlying implementation for thread-safe queues
        used within the core library

        When in doubt, use STDMUTEX

    config CORE_QUEUE_DEFAULT_STDMUTEX
        select CORE_QUEUE_STDMUTEX_ENABLE
        bool "std::mutex"

    config CORE_QUEUE_DEFAULT_LOCKFREE
        select CORE_QUEUE_LOCKFREE_ENABLE
        bool "lockfree"

endchoice

config CORE_QUEUE_STDMUTEX_ENABLE
    bool "Enable queues using std::mutex"

config CORE_QUEUE_LOCKFREE_ENABLE
    bool "Enable queues using lockfree atomics"

endmenu
```

## logic/Kconfig
```kconfig
menu "Logic"

config EXAMPLE_LOGIC
    bool "Enable sample logic"
    help
        "sample config

endmenu
```
